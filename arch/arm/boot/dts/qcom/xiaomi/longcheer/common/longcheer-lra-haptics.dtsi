// SPDX-License-Identifier: GPL-2.0

&spmi_bus {
	qcom,pm660@1 {
		/delete-node/ qcom,haptics@c000;
		pm660_haptics: qcom,haptic@c000 {
			compatible = "qcom,qpnp-haptic";
			reg = <0xc000 0x100>;
			interrupts = <0x1 0xc0 0x0 IRQ_TYPE_EDGE_BOTH>,
				     <0x1 0xc0 0x1 IRQ_TYPE_EDGE_BOTH>;
			interrupt-names = "sc-irq", "play-irq";
			qcom,pmic-revid = <&pm660_revid>;
			qcom,pmic-misc = <&pm660_misc>;
			qcom,misc-clk-trim-error-reg = <0xf3>;
			qcom,actuator-type = "lra";
			qcom,play-mode = "buffer";
			qcom,vmax-mv = <2204>;
			qcom,ilim-ma = <800>;
			qcom,sc-deb-cycles = <8>;
			qcom,wave-shape = "sine";
			qcom,wave-play-rate-us = <4878>;
			qcom,int-pwm-freq-khz = <253>;
			qcom,brake-pattern = [02 02 01 00];
			qcom,wave-samples = [3e 3e 3e 00 00 00 00 00];
			qcom,wave-samples-two = [3e 3e 3e 3e 00 00 00 00];
			qcom,wave-samples-three = [3e 3e 3e 3e 3e 00 00 00];
			qcom,wave-rep-cnt = <1>;
			qcom,wave-samp-rep-cnt = <1>;
			qcom,lra-high-z = "opt1";
			qcom,lra-auto-res-mode = "none";
			qcom,lra-hw-auto-resonance;
			qcom,en-brake;
			qcom,lra-calibrate-at-eop = <0>;
		};
	};
};
