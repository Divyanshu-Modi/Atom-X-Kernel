## drivers/input/touchscreen/focal_ft8719/Kconfig
```kconfig
#
# Focaltech Touchscreen driver configuration
#

menuconfig TOUCHSCREEN_FOCAL_FT8719
	bool "Focaltech Touchscreen"
	depends on I2C
	select TOUCHSCREEN_FTS
	default n
	help
	  Say Y here if you have Focaltech touch panel.
	  If unsure, say N.

if TOUCHSCREEN_FOCAL_FT8719

config TOUCHSCREEN_FTS
	bool "Focaltech Touchscreen"
	help
		Say Y here if you have Focaltech touch panel.
		If unsure, say N.

config TOUCHSCREEN_FTS_DIRECTORY
	string "Focaltech ts directory name"
	default "focaltech_touch"
	depends on TOUCHSCREEN_FTS

endif
```

## drivers/input/touchscreen/nvt_touch_a/Kconfig
```kconfig
# SPDX-License-Identifier: GPL-2.0
#
# Novatek NT36xxx touchscreen driver configuration
#
config TOUCHSCREEN_NVT_A
	tristate "novatek touchscreens"
	help
	  Say Y here if you have a nvt touchscreen.
	  nvt controllers are multi touch controllers which can
	  report 5 touches at a time.

	  If unsure, say N.

	  To compile this driver as a module, choose M here: the
	  module will be called nvt.
	  
config BOOT_FW_UPDATE_NVT_A
	tristate "boot firmware update function for novatek touchscreens"
	depends on TOUCHSCREEN_NVT_A
	help
	  Say Y here if you want to enable boot firmware update.

	  If unsure, say N.
```

## drivers/input/touchscreen/nvt_touch_e7s/Kconfig
```kconfig
# SPDX-License-Identifier: GPL-2.0
#
# Novatek NT36xxx touchscreen driver configuration
#
config TOUCHSCREEN_NVT_E7S
	tristate "novatek touchscreens"
	help
	  Say Y here if you have a nvt touchscreen.
	  nvt controllers are multi touch controllers which can
	  report 5 touches at a time.

	  If unsure, say N.

	  To compile this driver as a module, choose M here: the
	  module will be called nvt.
```

## drivers/input/touchscreen/nvt_touch_f7a/Kconfig
```kconfig
#
# Novatek NT36xxx touchscreen driver configuration
#
config TOUCHSCREEN_NVT_F7A
	tristate "novatek touchscreens"
	help
	  Say Y here if you have a nvt touchscreen.
	  nvt controllers are multi touch controllers which can
	  report 5 touches at a time.

	  If unsure, say N.

	  To compile this driver as a module, choose M here: the
	  module will be called nvt.

config BOOT_FIRMWARE_UPDATE_NVT_F7A
	tristate "boot firmware update function for novatek touchscreens"
	depends on TOUCHSCREEN_NVT_F7A
	help
	  Say Y here if you want to enable boot firmware update.

	  If unsure, say N.
```

## drivers/input/touchscreen/synaptics_dsx_e7s/Kconfig
```kconfig
#
# Synaptics DSX touchscreen driver configuration
#
menuconfig TOUCHSCREEN_SYNAPTICS_DSX_E7S
	bool "Synaptics DSX touchscreen"
	help
	  Say Y here if you have a Synaptics DSX touchscreen connected
	  to your system.

	  If unsure, say N.

if TOUCHSCREEN_SYNAPTICS_DSX_E7S

choice
	default TOUCHSCREEN_SYNAPTICS_DSX_I2C_E7S
	prompt "Synaptics DSX bus interface"
config TOUCHSCREEN_SYNAPTICS_DSX_I2C_E7S
	bool "RMI over I2C"
	depends on I2C
config TOUCHSCREEN_SYNAPTICS_DSX_SPI_E7S
	bool "RMI over SPI"
	depends on SPI_MASTER
config TOUCHSCREEN_SYNAPTICS_DSX_RMI_HID_I2C_E7S
	bool "HID over I2C"
	depends on I2C
endchoice

config TOUCHSCREEN_SYNAPTICS_DSX_CORE_E7S
	tristate "Synaptics DSX core driver module"
	depends on I2C || SPI_MASTER
	default y
	help
	  Say Y here to enable basic touch reporting functionality.

	  If unsure, say N.

	  To compile this driver as a module, choose M here: the
	  module will be called synaptics_dsx_core.

if TOUCHSCREEN_SYNAPTICS_DSX_CORE_E7S

config TOUCHSCREEN_SYNAPTICS_DSX_RMI_DEV_E7S
	tristate "Synaptics DSX RMI device module"
	default y
	help
	  Say Y here to enable support for direct RMI register access.

	  If unsure, say N.

	  To compile this driver as a module, choose M here: the
	  module will be called synaptics_dsx_rmi_dev.

config TOUCHSCREEN_SYNAPTICS_DSX_FW_UPDATE_E7S
	tristate "Synaptics DSX firmware update module"
	default y
	help
	  Say Y here to enable support for doing firmware update.

	  If unsure, say N.

	  To compile this driver as a module, choose M here: the
	  module will be called synaptics_dsx_fw_update.

config TOUCHSCREEN_SYNAPTICS_DSX_TEST_REPORTING_E7S
	tristate "Synaptics DSX test reporting module"
	default y
	help
	  Say Y here to enable support for retrieving production test reports.

	  If unsure, say N.

	  To compile this driver as a module, choose M here: the
	  module will be called synaptics_dsx_test_reporting.

config TOUCHSCREEN_SYNAPTICS_DSX_PROXIMITY_E7S
	tristate "Synaptics DSX proximity module"
	help
	  Say Y here to enable support for proximity functionality.

	  If unsure, say N.

	  To compile this driver as a module, choose M here: the
	  module will be called synaptics_dsx_proximity.

config TOUCHSCREEN_SYNAPTICS_DSX_ACTIVE_PEN_E7S
	tristate "Synaptics DSX active pen module"
	help
	  Say Y here to enable support for active pen functionality.

	  If unsure, say N.

	  To compile this driver as a module, choose M here: the
	  module will be called synaptics_dsx_active_pen.

config TOUCHSCREEN_SYNAPTICS_DSX_GESTURE_E7S
	tristate "Synaptics DSX user defined gesture module"
	help
	  Say Y here to enable support for user defined gesture functionality.

	  If unsure, say N.

	  To compile this driver as a module, choose M here: the
	  module will be called synaptics_dsx_gesture.

config TOUCHSCREEN_SYNAPTICS_DSX_VIDEO_E7S
	tristate "Synaptics DSX video module"
	help
	  Say Y here to enable support for video communication functionality.

	  If unsure, say N.

	  To compile this driver as a module, choose M here: the
	  module will be called synaptics_dsx_video.

config TOUCHSCREEN_SYNAPTICS_DSX_DEBUG_E7S
	tristate "Synaptics DSX debug module"
	help
	  Say Y here to enable support for firmware debug functionality.

	  If unsure, say N.

	  To compile this driver as a module, choose M here: the
	  module will be called synaptics_dsx_debug.

endif
endif
```

## drivers/platform/xiaomi/Kconfig
```kconfig
#------------------------------#
# Xiaomi configuration options #
#------------------------------#

config MACH_XIAOMI
	bool "Xiaomi device"
	depends on ARCH_QCOM
	help
	  Support for Xiaomi Products.

config MACH_XIAOMI_SDM660
	bool "Xiaomi SDM660"
	depends on ARCH_SDM660
	select MACH_XIAOMI
	help
	  Support for Xiaomi SDM660 Platform Devices.

menu "Xiaomi board selection"

	config MACH_LONGCHEER
		bool "Longcheer board"
		select MACH_XIAOMI_SDM660
		help
		  Support for Xiaomi's Longcheer boards.

	config MACH_XIAOMI_LAVENDER
		bool "Xiaomi lavender board"
		select MACH_LONGCHEER
		help
		  Support for Xiaomi Redmi Note 7.

	config MACH_XIAOMI_TULIP
		bool "Xiaomi tulip board"
		select MACH_LONGCHEER
		help
		  Support for Xiaomi Redmi Note 6 Pro.

	config MACH_XIAOMI_WHYRED
		bool "Xiaomi whyred board"
		select MACH_LONGCHEER
		help
		  Support for Xiaomi Redmi Note 5 (Pro).

	config MACH_XIAOMI_JASWAY
		bool "Xiaomi jasmine/wayne board"
		select MACH_LONGCHEER
		help
		  Support for Xiaomi MI 6X/A2 variant.

endmenu
```

## sound/soc/codecs/dbmdx/Kconfig
```kconfig
config SND_SOC_DBMDX
	bool "DSPG Voice Trigger/Enhancement Chip"
	depends on SND_SOC_SDM660_CDC	
	default n
	help
		DSPG Voice Trigger/Enhancement Chip

config SND_SOC_DBMDX_SND_CAPTURE
	bool "DSPG Capture Device Support"
	depends on SND_SOC_DBMDX
	help
		DSPG Capture Device Support
```

## sound/soc/codecs/sdm660_cdc/Kconfig
```kconfig
config SND_SOC_SDM660_CDC
	tristate "MSM Internal PMIC based codec"
	
config SOUND_CONTROL
	bool "Sound Control for sdm660"	
	depends on SND_SOC_SDM660_CDC
```

## sound/soc/codecs/tas2557/Kconfig
```kconfig
config SND_SOC_TAS2557
	bool "Texas Instruments TAS2557 SmartAmp(R)"
	depends on SND_SOC_SDM660_CDC
	default y if KERNEL_XIAOMI_SDM660
    help
       Texas Instruments TAS2557 SmartAmp(R)

config TAS2557_REGMAP
    bool "Use of Tas2557 RegMap API"
	depends on SND_SOC_TAS2557
	help
		Use of Tas2557 RegMap API
		
config TAS2557_CODEC
    bool "Tas2557 Codec Driver support"
	depends on SND_SOC_TAS2557
	help
		Tas2557 Codec Driver support
			
config TAS2557_MISC
    bool "Tas2557 Misc Driver support"
	depends on SND_SOC_TAS2557
	help
		Tas2557 Misc Driver support
```
